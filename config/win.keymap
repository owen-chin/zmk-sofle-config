/ {
    keymap {
        compatible = "zmk,keymap";

        layers {
            LAYER_0 {
                bindings = <
                    // Same order as your original keymap bottom row:
                    &kp C_MUTE    &kp LEFT_WIN  &kp LEFT_CONTROL  &kp LEFT_ALT  &kp SPACE
                    &mo 1         &kp ENTER     &mo 2             &kp SPACE     &kp DELETE
                    &kp RIGHT_CONTROL  &kp RETURN
                >;
            };
        };
    };
};
